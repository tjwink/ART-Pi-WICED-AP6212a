/*
 * Copyright 2018, Cypress Semiconductor Corporation or a subsidiary of 
 * Cypress Semiconductor Corporation. All Rights Reserved.
 * 
 * This software, associated documentation and materials ("Software"),
 * is owned by Cypress Semiconductor Corporation
 * or one of its subsidiaries ("Cypress") and is protected by and subject to
 * worldwide patent protection (United States and foreign),
 * United States copyright laws and international treaty provisions.
 * Therefore, you may use this Software only as provided in the license
 * agreement accompanying the software package from which you
 * obtained this Software ("EULA").
 * If no EULA applies, Cypress hereby grants you a personal, non-exclusive,
 * non-transferable license to copy, modify, and compile the Software
 * source code solely for use in connection with Cypress's
 * integrated circuit products. Any reproduction, modification, translation,
 * compilation, or representation of this Software except as specified
 * above is prohibited without the express written permission of Cypress.
 *
 * Disclaimer: THIS SOFTWARE IS PROVIDED AS-IS, WITH NO WARRANTY OF ANY KIND,
 * EXPRESS OR IMPLIED, INCLUDING, BUT NOT LIMITED TO, NONINFRINGEMENT, IMPLIED
 * WARRANTIES OF MERCHANTABILITY AND FITNESS FOR A PARTICULAR PURPOSE. Cypress
 * reserves the right to make changes to the Software without notice. Cypress
 * does not assume any liability arising out of the application or use of the
 * Software or any product or circuit described in the Software. Cypress does
 * not authorize its products for use in any products where a malfunction or
 * failure of the Cypress product may reasonably be expected to result in
 * significant property damage, injury or death ("High Risk Product"). By
 * including Cypress's product in a High Risk Product, the manufacturer
 * of such system or application assumes all risk of such use and in doing
 * so agrees to indemnify Cypress against all liability.
 */
/* OTA header location, this ia a header of the application not the actual OTA */
/* starts at 512 bytes before the end of ram - 0x1FFFFE00  */
define symbol __OTA_App_header_start                    = 0x1FFFFE00;
define symbol __OTA_App_header_length                   = 512;
define symbol __OTA_App_header_end                    = (__OTA_App_header_start + __OTA_App_header_length);

/* SRAM memory location */
/* starts at address 0x20000000 ends at address 0x20020000 */
define symbol __SRAM_start                        = 0x20000000;
define symbol __SRAM_length                       = 128K;
define symbol __SRAM_end                        = (__SRAM_start + __SRAM_length);

/* place OTA after data_config_section and data_transfer_section */
/* we assume that data_config_section and data transfer section will never be more that 512 bytes plus the jtag data buffer( this buffer is used by Jtag to */
/* supply bytes to the serial flash writer ) */
/* 0x20000000 + 512b = 0x20000200 */
define symbol __OTA_App_start                                   = 0x20000000 + 0x200 + __JTAG_FLASH_WRITER_DATA_BUFFER_SIZE__;


define symbol __Bootloader_api_start = 0x08000200;

/* Define memory regions */
define memory mem with size = 4G;
define region RAM_region   = mem:[from __SRAM_start   to __SRAM_end];


/* create a stack block */
define block CSTACK    with alignment = 8, size = __STACKSIZE__   { };
/* create a heap block */
define block HEAP      with alignment = 8, size = 0x10000     { };

keep {section data_config_section};
keep {section data_transfer_section};
keep {section bootloader_app_header_section};
keep {section wifi_firmware_image_section};



/* place application header */
place at address mem:__OTA_App_header_start   { section bootloader_app_header_section };
/* place jtag to serial flash interface structure to the beginning of the SRAM */
place at address mem:__SRAM_start { section data_config_section,
                                    section data_transfer_section };

initialize by copy { readwrite };


place at address mem: __OTA_App_start  {
                                          section .intvec,
                                          readwrite,
                                          readonly,
                                          zeroinit,
                                          section wifi_firmware_image_section,
                                          block CSTACK,
                                          block HEAP,
                                        };

/* export symbols */


define symbol bootloader_api_addr_loc = __Bootloader_api_start;
export symbol bootloader_api_addr_loc;

/* vectors offset */
define symbol vectors_offset = __OTA_App_start -  __OTA_App_header_start;
export symbol vectors_offset;

define symbol app_hdr_start_addr_loc = __OTA_App_header_start;
export symbol app_hdr_start_addr_loc;
